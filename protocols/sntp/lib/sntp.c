////////////////////////////////////////////////////////////////////////////////
// COPYRIGHT (c) 2023
// NOMNIO d.o.o.
// All rights reserved.
////////////////////////////////////////////////////////////////////////////////
/**
 *	@file		sntp.c
 *	@author   	Tibor Sovilj
 *	@date		24.10.2023
 *	@version	V1.0.0

 *	@brief 		Source file for the SNTP protocol.
 */
////////////////////////////////////////////////////////////////////////////////

////////////////////////////////////////////////////////////////////////////////
/**
 *	@addtogroup SNTP_STATIC
 *	@{ <!-- BEGIN GROUP -->
 */
////////////////////////////////////////////////////////////////////////////////

////////////////////////////////////////////////////////////////////////////////
// Includes
////////////////////////////////////////////////////////////////////////////////
#include <stdio.h>

#include "esp_log.h"
#include "lwip/apps/sntp.h"

#include "freertos/FreeRTOS.h"
#include "freertos/task.h"

#include "../../project_config.h"
#include "../../wifi/lib/wifi.h"
#include "../../http/lib/http_server.h"
#include "../config/sntp_cfg.h"
#include "sntp.h"

////////////////////////////////////////////////////////////////////////////////
// Definitions
////////////////////////////////////////////////////////////////////////////////

////////////////////////////////////////////////////////////////////////////////
// Static Typedefs
////////////////////////////////////////////////////////////////////////////////

////////////////////////////////////////////////////////////////////////////////
// Static Global Variables
////////////////////////////////////////////////////////////////////////////////

// Flag for detecting if SNTP operation mode is set
static bool g_sntp_op_mode_set = false;

// Global carrier of configuration parameters
static sntp_config_t* gp_sntp_config_table = NULL;


////////////////////////////////////////////////////////////////////////////////
// Static Function Prototypes
////////////////////////////////////////////////////////////////////////////////
static void sntp_time_sync_task	(void *pvParam);
static void sntp_obtain_time	(void);
static void sntp_init_sntp		(void);


////////////////////////////////////////////////////////////////////////////////
// Static Function Definitions
////////////////////////////////////////////////////////////////////////////////

////////////////////////////////////////////////////////////////////////////////
/**
 * @brief       The SNTP time synchronization task.
 * 
 * @param[in]   arg pvParam.
 * @return      void
 */
////////////////////////////////////////////////////////////////////////////////
static void sntp_time_sync_task(void *pvParam)
{
	while (1)
	{
		sntp_obtain_time();
		vTaskDelay(gp_sntp_config_table->obtainPeriod / portTICK_PERIOD_MS);
	}

	vTaskDelete(NULL);
}

////////////////////////////////////////////////////////////////////////////////
/**
 * @brief   Gets the current time and if the current time is not up to date,
 *          the sntp_time_synch_init_sntp function is called.
 * 
 * @return 	void
 */
////////////////////////////////////////////////////////////////////////////////
static void sntp_obtain_time(void)
{
	time_t now = 0;
	struct tm time_info = {0};

	time(&now);
	localtime_r(&now, &time_info);

	// Check the time, in case we need to initialize/reinitialize
	if (time_info.tm_year < (gp_sntp_config_table->curentYear - 1900))
	{
		sntp_init_sntp();

		// Setting the local time zone as enviromental variable
        // SOURCE: https://github.com/nayarsystems/posix_tz_db/blob/master/zones.csv
		setenv("TZ", gp_sntp_config_table->timeZone, 1);
		tzset();
	}
}

////////////////////////////////////////////////////////////////////////////////
/**
 * @brief   Initialize SNTP service using SNTP_OPMODE_POLL mode.
 * 
 * @return  void
 */
////////////////////////////////////////////////////////////////////////////////
static void sntp_init_sntp(void)
{
	printf("Initializing the SNTP service\n");

	if (!g_sntp_op_mode_set)
	{
		// Set the operating mode
		sntp_setoperatingmode(gp_sntp_config_table->opMode);
		g_sntp_op_mode_set = true;
	}

	sntp_setservername(0, gp_sntp_config_table->serverName);

	// Initialize the servers
	sntp_init();

	// Let the http_server know service is initialized
	http_server_monitor_send_message(HTTP_MSG_TIME_SERVICE_INITIALIZED);
}

////////////////////////////////////////////////////////////////////////////////
/**
 *	@} <!-- END GROUP -->
 */
////////////////////////////////////////////////////////////////////////////////

////////////////////////////////////////////////////////////////////////////////
/**
 *	@addtogroup SNTP_API
 *	@{ <!-- BEGIN GROUP -->
 */
////////////////////////////////////////////////////////////////////////////////

////////////////////////////////////////////////////////////////////////////////
// API Function Definitions
////////////////////////////////////////////////////////////////////////////////

////////////////////////////////////////////////////////////////////////////////
/**
 * @brief   Starts the SNTP synchronization task.
 * 
 * @return  void
 */
////////////////////////////////////////////////////////////////////////////////
void sntp_task_start (void)
{
	// call table
	gp_sntp_config_table = sntp_get_config();

    xTaskCreate(&sntp_time_sync_task, "sntp_time_sync_task", SNTP_TASK_STACK_SIZE, NULL, SNTP_TASK_PRIORITY, NULL);
}

////////////////////////////////////////////////////////////////////////////////
/**
 * @brief   Returns local time if set.
 * 
 * @return  void
 */
////////////////////////////////////////////////////////////////////////////////
char* sntp_get_time (void)
{
    static char time_buffer[100] = {0};

	time_t now = 0;
	struct tm time_info = {0};

	time(&now);
	localtime_r(&now, &time_info);

	if (time_info.tm_year < (gp_sntp_config_table->curentYear - 1900))
	{
		printf("Time is not set yet\n");
	}
	else
	{
		strftime(time_buffer, sizeof(time_buffer), "%d.%m.%Y %H:%M:%S", &time_info);
		printf("Current time info: %s\n", time_buffer);
	}

	return time_buffer;
}


////////////////////////////////////////////////////////////////////////////////
/**
 *	@} <!-- END GROUP -->
 */
////////////////////////////////////////////////////////////////////////////////